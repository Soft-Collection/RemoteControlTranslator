#include <Arduino.h>

#define DECODE_NEC

#include "PinDefinitionsAndMore.h"
#include <IRremote.hpp>

#define SOURCE_RC_ADDRESS 0x40
#define TARGET_RC_ADDRESS 0x20
#define NUMBER_OF_REPEATS_TO_IGNORE 10

const uint8_t translationTable[] PROGMEM = {
    //       00    01    02    03    04    05    06    07    08    09    0A    0B    0C    0D    0E    0F
    /*00*/ 0x1B, 0x00, 0x10, 0x11, 0x13, 0x14, 0x15, 0x17, 0x18, 0x19, 0x4A, 0x0D, 0xFF, 0xFF, 0xFF, 0x20, 
    /*10*/ 0x53, 0xFF, 0x52, 0xFF, 0x40, 0x01, 0x42, 0xFF, 0xFF, 0x47, 0x02, 0x03, 0x1D, 0x4D, 0x09, 0x41, 
    /*20*/ 0xFF, 0xFF, 0xFF, 0xFF, 0xFF, 0xFF, 0xFF, 0xFF, 0xFF, 0xFF, 0xFF, 0xFF, 0xFF, 0xFF, 0xFF, 0xFF, 
    /*30*/ 0xFF, 0xFF, 0xFF, 0xFF, 0xFF, 0xFF, 0xFF, 0xFF, 0xFF, 0xFF, 0xFF, 0xFF, 0xFF, 0xFF, 0xFF, 0xFF, 
    /*40*/ 0x0A, 0xFF, 0xFF, 0xFF, 0x4E, 0xFF, 0x49, 0x4B, 0xFF, 0x06, 0x5C, 0x5D, 0x5E, 0x5F, 0xFF, 0xFF, 
    /*50*/ 0xFF, 0xFF, 0xFF, 0xFF, 0xFF, 0x58, 0xFF, 0xFF, 0x05, 0xFF, 0xFF, 0xFF, 0xFF, 0xFF, 0xFF, 0xFF, 
    /*60*/ 0xFF, 0xFF, 0xFF, 0xFF, 0xFF, 0xFF, 0xFF, 0xFF, 0xFF, 0xFF, 0xFF, 0xFF, 0xFF, 0xFF, 0xFF, 0xFF, 
    /*70*/ 0xFF, 0xFF, 0xFF, 0xFF, 0xFF, 0xFF, 0xFF, 0xFF, 0xFF, 0xFF, 0xFF, 0xFF, 0xFF, 0xFF, 0xFF, 0xFF, 
    /*80*/ 0xFF, 0xFF, 0xFF, 0xFF, 0xFF, 0xFF, 0xFF, 0xFF, 0xFF, 0xFF, 0xFF, 0xFF, 0xFF, 0xFF, 0xFF, 0xFF, 
    /*90*/ 0xFF, 0xFF, 0xFF, 0xFF, 0xFF, 0xFF, 0xFF, 0xFF, 0xFF, 0xFF, 0xFF, 0xFF, 0xFF, 0xFF, 0xFF, 0xFF, 
    /*A0*/ 0xFF, 0xFF, 0xFF, 0xFF, 0xFF, 0xFF, 0xFF, 0xFF, 0xFF, 0xFF, 0xFF, 0xFF, 0xFF, 0xFF, 0xFF, 0xFF, 
    /*B0*/ 0xFF, 0xFF, 0xFF, 0xFF, 0xFF, 0xFF, 0xFF, 0xFF, 0xFF, 0xFF, 0xFF, 0xFF, 0xFF, 0xFF, 0xFF, 0xFF, 
    /*C0*/ 0xFF, 0xFF, 0xFF, 0xFF, 0xFF, 0xFF, 0xFF, 0xFF, 0xFF, 0xFF, 0xFF, 0xFF, 0xFF, 0xFF, 0xFF, 0xFF, 
    /*D0*/ 0xFF, 0xFF, 0xFF, 0xFF, 0xFF, 0xFF, 0xFF, 0xFF, 0xFF, 0xFF, 0xFF, 0xFF, 0xFF, 0xFF, 0xFF, 0xFF, 
    /*E0*/ 0xFF, 0xFF, 0xFF, 0xFF, 0xFF, 0xFF, 0xFF, 0xFF, 0xFF, 0xFF, 0xFF, 0xFF, 0xFF, 0xFF, 0xFF, 0xFF, 
    /*F0*/ 0xFF, 0xFF, 0xFF, 0xFF, 0xFF, 0xFF, 0xFF, 0xFF, 0xFF, 0xFF, 0xFF, 0xFF, 0xFF, 0xFF, 0xFF, 0xFF, 
};

void setup() 
{
    //--------------------------------------------
    pinMode(LED_BUILTIN, OUTPUT);
    //--------------------------------------------
    Serial.begin(115200);
    while (!Serial); //Wait for Serial to become available. Is optimized away for some cores.
    //--------------------------------------------
    //Start the receiver and if not 3. parameter specified, take LED_BUILTIN pin from the internal boards definition as default feedback LED
    IrReceiver.begin(IR_RECEIVE_PIN, ENABLE_LED_FEEDBACK);
    //--------------------------------------------
    //The IR library setup. That's all!
    IrSender.begin(); //Start with IR_SEND_PIN -which is defined in PinDefinitionsAndMore.h- as send pin and enable feedback LED at default feedback LED pin
    disableLEDFeedback(); //Disable feedback LED at default feedback LED pin
    //--------------------------------------------
}

void loop() 
{
    static int32_t repeats_count = 0;
    IrReceiver.resume(); //Early enable receiving of the next IR frame
    while (!IrReceiver.decode());
    Serial.println("----------------------------------------");
    if (IrReceiver.decodedIRData.flags & IRDATA_FLAGS_IS_REPEAT) repeats_count++; else repeats_count = 0;
    Serial.print("Repeats Count: ");
    Serial.println(repeats_count);
    if ((repeats_count > 0) and (repeats_count < NUMBER_OF_REPEATS_TO_IGNORE)) return;
    Serial.print("Protocol: ");
    Serial.println(IrReceiver.decodedIRData.protocol);
    Serial.print("Address: ");
    Serial.println(IrReceiver.decodedIRData.address);
    Serial.print("Command: ");
    Serial.println(IrReceiver.decodedIRData.command);
    Serial.print("Decoded Raw Data: ");
    Serial.println(IrReceiver.decodedIRData.decodedRawData);
    Serial.print("Last Decoded Address: ");
    Serial.println(IrReceiver.lastDecodedAddress);
    Serial.print("Last Decoded Command: ");
    Serial.println(IrReceiver.lastDecodedCommand);
    Serial.print("Flags: ");
    Serial.println(IrReceiver.decodedIRData.flags);
    Serial.print("Extra: ");
    Serial.println(IrReceiver.decodedIRData.extra);
    Serial.print("Initial Gap Ticks: ");
    Serial.println(IrReceiver.decodedIRData.initialGapTicks);
    if (IrReceiver.decodedIRData.address == SOURCE_RC_ADDRESS)
    {
        uint8_t commandToSend = pgm_read_byte(&translationTable[IrReceiver.decodedIRData.command]);
        if (commandToSend != 0xFF)
        {
            Serial.print("Command To Send: ");
            Serial.println(commandToSend);
            IrSender.sendNEC(TARGET_RC_ADDRESS, commandToSend, 0);
            IrReceiver.restartAfterSend();
        }
    }
}
